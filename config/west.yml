## config/west.yml
```yaml
manifest:
  remotes:
    - name: zmkfirmware
      url-base: https://github.com/zmkfirmware
    - name: mentako-ya
      url-base: https://github.com/mentako-ya
    - name: badjeff
      url-base: https://github.com/badjeff
    - name: caksoylar
      url-base: https://github.com/caksoylar
    - name: englmaxi
      url-base: https://github.com/englmaxi
  projects:
    - name: zmk
      remote: zmkfirmware
      revision: 19582174f3a446a07d40f479020b4ebb1aad8ddb
      import: app/west.yml
    - name: zmk-pmw3610-driver
      remote: badjeff
      revision: a1a0f35ab6750c8fc72b84ea00add1e5fbaea1e4
    - name: zmk-rgbled-widget
      remote: caksoylar
      revision: a3510c9de46de8b42c803286f4978466c6ea3916
  self:
    path: config
```
